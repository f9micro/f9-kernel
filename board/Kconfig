## board/Kconfig
```kconfig
# Copyright (c) 2013 The F9 Microkernel Project. All rights reserved.
# Use of this source code is governed by a BSD-style license that can be
# found in the LICENSE file.

menu "Board"

choice
	prompt "Target Board"
	default BOARD_STM32F4DISCOVERY
	help
	  Select the target board for F9 Microkernel.

config BOARD_STM32F4DISCOVERY
	bool "STM32F4 Discovery"
	select PLATFORM_STM32F4
	help
	  STM32F4 Discovery board with STM32F407VGT6 MCU.

config BOARD_STM32F429DISCOVERY
	bool "STM32F429 Discovery"
	select PLATFORM_STM32F429
	help
	  STM32F429 Discovery board with STM32F429ZIT6 MCU and LCD.

config BOARD_NETDUINOPLUS2
	bool "Netduino Plus 2"
	select PLATFORM_STM32F4
	help
	  Netduino Plus 2 board with STM32F405RGT6 MCU.
	  This board is supported by upstream QEMU for emulation.

config BOARD_STM32F429NUCLEO
	bool "STM32F429 Nucleo"
	select PLATFORM_STM32F429
	help
	  STM32F429 Nucleo board with STM32F429ZIT6 MCU.

endchoice

config QEMU
	bool "QEMU emulation mode"
	default y if BOARD_NETDUINOPLUS2
	help
	  Enable workarounds for QEMU emulation limitations:
	  - Use synchronous UART output (QEMU TXE interrupt unreliable)
	  - Place bitmaps in regular SRAM (QEMU lacks CCM RAM emulation)

	  Enable this when running under QEMU. Disable for real hardware
	  to get better performance.

# Hardware feature availability flags
# These control which ARM architecture tests can run based on
# platform capabilities and emulation limitations.

config HAS_PRECISE_TIMING
	bool "Cycle-accurate timing available (DWT/SysTick)"
	default !QEMU
	help
	  Enable tests that require cycle-accurate timing measurements.
	  This covers DWT cycle counter and SysTick precision timing.

	  Tests requiring this feature:
	  - FPU lazy stacking timing (requires DWT cycle counter)
	  - Interrupt latency measurement (requires SysTick precision)

	  Disabled in QEMU because timing is not cycle-accurate.

config MPU_MOCK
	bool "Software MPU mock for testing"
	depends on QEMU
	default y if QEMU
	help
	  Enable minimal MPU register mock for test_arm_mpu_config in QEMU.

	  Returns MPU_TYPE = 0x800 (8 regions, unified) to validate that
	  MPU_TYPE register is readable without QEMU hanging.

	  For full MPU validation, test on real hardware with actual MPU.

config SCB_MOCK
	bool "Software SCB mock for testing"
	depends on QEMU
	default y if QEMU
	help
	  Enable minimal SCB register mock for test_arm_unaligned in QEMU.

	  Returns SCB_CCR = 0x200 (STKALIGN enabled, UNALIGN_TRP disabled)
	  to validate SCB_CCR register readability without QEMU hanging.

	  For full SCB validation, test on real hardware with actual SCB.

endmenu

# Platform symbols (selected by board choice)
config PLATFORM_STM32F4
	bool

config PLATFORM_STM32F429
	bool
```

## board/nucleof429/defconfig
```kconfig
CONFIG_BOARD_STM32F429NUCLEO=y
CONFIG_DBGPORT_USE_USART3=y
CONFIG_EXTI0_USER_IRQ=y
CONFIG_EXTI1_USER_IRQ=y
CONFIG_ETH_USER_IRQ=y
CONFIG_BUILD_USER_APPS=y
CONFIG_PINGPONG=y
CONFIG_EXTI_INTERRUPT_TEST=y
```

## kernel/Kconfig
```kconfig
# Copyright (c) 2013,2026 The F9 Microkernel Project. All rights reserved.
# Use of this source code is governed by a BSD-style license that can be
# found in the LICENSE file.

menu "Limitations"
config MAX_THREADS
	int "Maximum amount of threads"
	default 32

config MAX_KT_EVENTS
	int "Maximum amount of kernel timer events"
	default 64
endmenu

menu "Notification System"
comment "Uses RT-safe bounded processing (batch size: 4 events)"

config MAX_NOTIFICATIONS
	int "Maximum notifications in async queue"
	default 32
	range 8 256
	help
	  Maximum number of async notifications queued for delivery.
	  Each entry consumes 16 bytes of RAM.

	  Default (32) suitable for most applications.
	  Increase if you have many simultaneous timer events or IRQ sources.

	  RT-safe processing:
	  - Batch size: 4 events per softirq (200 cycle WCET)
	  - Bounded latency: Predictable performance
	  - No configuration needed: Best-practice defaults
endmenu

menu "Memory Management"
config MAX_ADRESS_SPACES
	int "Maximum of address space"
	default 16

config MAX_FPAGES
	int "Maximum flexible pages"
	default 256
endmenu


menu "Kernel Timer"
config KTIMER_TICKLESS
	bool "Tickless scheduling"
	default y

config KTIMER_TICKLESS_VERIFY
	bool "Track tickless scheduling status"
	depends on KTIMER_TICKLESS
	default n

config KTIMER_TICKLESS_COMPENSATION
	int "Tickless compensation"
	depends on KTIMER_TICKLESS
	default 0

config KTIMER_TICKLESS_INT_COMPENSATION
	int "Tickless interrupt compensation"
	depends on KTIMER_TICKLESS
	default 0

config KTIMER_HEARTBEAT
	int "Heartbeat value of ktimer"
	default 65536
	help
	  Current implementation utilizes SysTick, and the value of
	  CONFIG_KTIMER_HEARTBEAT is its initial reload value.

config KTIMER_MINTICKS
	int "Minimal ticks scheduled by ktimer"
	default 128

config KTIMER_DIRECT_NOTIFY
	bool "Direct timer notification delivery"
	default n
	help
	  Enable direct notification delivery from timer interrupt context,
	  bypassing the async event queue and softirq for ultra-low latency.

	  When enabled, timer notifications (ktimer_event_create_notify) deliver
	  directly to target threads from the timer IRQ handler, providing
	  deterministic latency:
	  - Normal path: Timer → async_event_post → softirq → notification (150-1750 cycles)
	  - Direct path:  Timer → notification (150 cycles, 91% reduction)

	  Benefits:
	  - Ultra-low latency (150 cycles)
	  - Deterministic delivery (no queue, no softirq)
	  - Real-time predictability

	  Trade-offs:
	  - Callback executes in IRQ context (must be short)
	  - Higher IRQ latency for other interrupts
	  - Only safe with non-blocking callbacks

	  Recommended: Y for hard real-time timer applications, N for general use

endmenu

menu "Flexible page tweaks"
config LARGEST_FPAGE_SHIFT
	int "Largest shift of flexible pages"
	default 16

config SMALLEST_FPAGE_SHIFT
	int "Smallest shift of flexible pages"
	default 8
endmenu

menu "Thread tweaks"
config INTR_THREAD_MAX
	int "Maximum of interrupt threads"
	default 256
endmenu

menu "KIP tweaks"
config KIP_EXTRA_SIZE
	int "Size of extra information on KIP"
	default 128
endmenu


menu "Kernel hacking"
config DEBUG
	bool "Debug IO facilities"
	default y

if DEBUG
source "platform/Kconfig.debug"
endif

config KDB
	bool "Kdb: kernel debugger"
	default y
	select DEBUG
	select DEBUG_DEV_UART

config KPROBES
	bool "KProbes: dynamic instrumentation system"
	default y

config SYMMAP
	bool "Generate symbol map"
	default y
	depends on KPROBES

config PANIC_DUMP_STACK
	bool "Dump kernel stack while panic"
	default y

endmenu
```

## loader/Kconfig
```kconfig
# Copyright (c) 2013 The F9 Microkernel Project. All rights reserved.
# Use of this source code is governed by a BSD-style license that can be
# found in the LICENSE file.

menu "Loader"

config LOADER
	bool "Build loader to load f9"
	default n

endmenu
```

## mk/Config.in
```kconfig
# Copyright (c) 2013 The F9 Microkernel Project. All rights reserved.
# Use of this source code is governed by a BSD-style license that can be
# found in the LICENSE file.

mainmenu "F9 Microkernel Configurations"

menu "Limitations"
config MAX_THREADS
	int "Maximum amount of threads"
	default 32

config MAX_KT_EVENTS
	int "Maximum amount of kernel timer events"
	default 64

config MAX_ASYNC_EVENTS
	int "Maximum of asynchronous events"
	default 32

config MAX_ADRESS_SPACES
	int "Maximum of address space"
	default 16

config MAX_FPAGES
	int "Maximum flexible pages"
	default 256
endmenu

source platform/Kconfig

source kernel/Kconfig

config SYMMAP
	bool "Generate symbol map"
	default y
	depends on KPROBES

config BITMAP_BITBAND
	bool "Generate bitmap address in bit-band region"
	default y

config FPU
	bool "Floating point support"
	default n
```

## platform/Kconfig
```kconfig
# Copyright (c) 2013 The F9 Microkernel Project. All rights reserved.
# Use of this source code is governed by a BSD-style license that can be
# found in the LICENSE file.

menu "Platform"

choice
	prompt "Platform"
	default BOARD_STM32F4DISCOVERY

config BOARD_STM32F4DISCOVERY
	bool "STM32F4"

config BOARD_STM32F429DISCOVERY
	bool "STM32F429"

config BOARD_STM32P103
	bool "STM32P103"

endchoice

config BITMAP_BITBAND
	bool "Generate bitmap address in bit-band region"
	default n

config FPU
	bool "Floating point support"
	default n
	depends on !BOARD_STM32P103

config SEMIHOST
	bool "Semihosting enable"
	default n
	depends on BOARD_STM32P103

choice
	prompt "Standard I/O device"
	default STDIO_USE_DBGPORT
	help
	  Select input/output device for stdio

config STDIO_NODEV
	bool "Null device"

config STDIO_USE_DBGPORT
	bool "Debug serial IO"
	select DEBUG

endchoice

choice
	prompt "Debug serial IO uses"
	default DBGPORT_USE_USART4
	depends on STDIO_USE_DBGPORT

config DBGPORT_USE_USART1
	bool "USART1"
config DBGPORT_USE_USART2
	bool "USART2"
config DBGPORT_USE_USART4
	bool "USART4"

endchoice

if BOARD_STM32F4DISCOVERY
source platform/stm32f4/Kconfig
endif
if BOARD_STM32F429DISCOVERY
source platform/stm32f429/Kconfig
endif
if BOARD_STM32P103
source platform/stm32f1/Kconfig
endif

endmenu
```

## platform/Kconfig.debug
```kconfig
# Copyright (c) 2013 The F9 Microkernel Project. All rights reserved.
# Use of this source code is governed by a BSD-style license that can be
# found in the LICENSE file.

if DEBUG
config DEBUG_DEV_UART
	bool "UART based implementation"
	default y
	help
	  At present, it is the only device for KDB use.

if !KDB
config DEBUG_DEV_RAM
	bool "RAM based virtual device"
	default n
	help
	  A simple implementation of RAM base virtual debug device
endif

endif
```

## platform/stm32f1/Kconfig
```kconfig
menu "User Interrupt Config"

config WWDG_USER_IRQ
	bool "User WWDG IRQ"
	default n

config PVD_USER_IRQ
	bool "User PVD IRQ"
	default n

config TAMP_STAMP_USER_IRQ
	bool "User TAMP_STAMP IRQ"
	default n

config RTC_WKUP_USER_IRQ
	bool "User RTC_WKUP IRQ"
	default n

config FLASH_USER_IRQ
	bool "User FLASH_USER IRQ"
	default n

config RCC_USER_IRQ
	bool "User RCC IRQ"
	default n

config EXTI0_USER_IRQ
	bool "User EXTI0 IRQ"
	default n

config EXTI1_USER_IRQ
	bool "User EXIT1 IRQ"
	default n

config EXTI2_USER_IRQ
	bool "User EXIT2 IRQ"
	default n

config EXTI3_USER_IRQ
	bool "User EXIT3 IRQ"
	default n

config EXTI4_USER_IRQ
	bool "User EXIT4 IRQ"
	default n

config DMA_Stream0_USER_IRQ
	bool "User DMA_Stream0 IRQ"
	default n

config DMA_Stream1_USER_IRQ
	bool "User DMA_Stream1 IRQ"
	default n

config DMA_Stream2_USER_IRQ
	bool "User DMA_Stream2 IRQ"
	default n

config DMA_Stream3_USER_IRQ
	bool "User DMA_Stream3 IRQ"
	default n

config DMA_Stream4_USER_IRQ
	bool "User DMA_Stream4 IRQ"
	default n

config DMA_Stream5_USER_IRQ
	bool "User DMA_Stream5 IRQ"
	default n

config DMA_Stream6_USER_IRQ
	bool "User DMA_Stream6 IRQ"
	default n

config ADC_USER_IRQ
	bool "User ADC IRQ"
	default n

config CAN1_TX_USER_IRQ
	bool "CAN1 TX User IRQ"
	default n

config CAN1_RX_USER_IRQ
	bool "CAN1 RX User IRQ"
	default n

config CAN1_RX1_USER_IRQ
	bool "CAN1 RX1 User IRQ"
	default n

config CAN1_SCE_USER_IRQ
	bool "CAN1 SEC User IRQ"
	default n

config EXTI9_5_USER_IRQ
	bool "EXTI9_5 User IRQ"
	default n

config TIM1_BRK_USER_IRQ
 	bool "TIM1_BRK User IRQ"
	default n

config TIM1_UP_USER_IRQ
	bool "TIM1_UP User IRQ"
	default n

config TIM1_TRG_COM_USER_IRQ
	bool "TIM1_TRG_COM User IRQ"
	default n

config TIM1_CC_USER_IRQ
	bool "TIM1_CC User IRQ"
	default n

config TIM2_USER_IRQ       
	bool "TIM2 User IRQ"
	default n

config TIM3_USER_IRQ
	bool "TIM3 User IRQ"
	default n

config TIM4_USER_IRQ
	bool "TIM4 User IRQ"
	default n

config I2C1_EV_USER_IRQ
	bool "I2C1_EV User IRQ"
	default n

config I2C1_ER_USER_IRQ
	bool "I2C1_ER User IRQ"
	default n

config I2C2_EV_USER_IRQ
	bool "I2C2_EV User IRQ"
	default n

config I2C2_ER_USER_IRQ
	bool "I2C2_ER User IRQ"
	default n

config SPI1_USER_IRQ
	bool "SPI1 User IRQ"
	default n

config SPI2_USER_IRQ
	bool "SPI2 User IRQ"
	default n

config USART1_USER_IRQ
	bool "USART1 User IRQ"
	default n

config USART2_USER_IRQ
	bool "USART2 User IRQ"
	default n

config USART3_USER_IRQ
	bool "USART3 User IRQ"
	default n

config EXTI15_10_USER_IRQ
	bool "EXTI15_10 User IRQ"
	default n

config RTC_Alarm_USER_IRQ
	bool "RTC Alarm User IRQ"
	default n

config OTG_FS_WKUP_USER_IRQ
	bool "OTG_FS_WKUP User IRQ"
	default n

endmenu
```
